## boards/shields/macro32/Kconfig.shield
```kconfig
config SHIELD_MACRO32
    def_bool $(shields_list_contains,macro32)
    select ADC
    select GPIO
```

## boards/shields/macro32/boards/nice_nano_v2.conf
```kconfig
# nice_nano v2 specific configuration

# Enable display
CONFIG_ZMK_DISPLAY=y
CONFIG_ZMK_DISPLAY_STATUS_SCREEN_BUILT_IN=y

# SPI for nice!view display
CONFIG_SPI=y

# Encoder support
CONFIG_EC11=y
CONFIG_EC11_TRIGGER_GLOBAL_THREAD=y

# Power management
CONFIG_ZMK_SLEEP=y
CONFIG_ZMK_IDLE_SLEEP_TIMEOUT=300000

# Flash/NVS
CONFIG_FLASH=y
CONFIG_FLASH_PAGE_LAYOUT=y
CONFIG_FLASH_MAP=y
CONFIG_MPU_ALLOW_FLASH_WRITE=y
CONFIG_NVS=y
CONFIG_SETTINGS=y
CONFIG_SETTINGS_NVS=y

# Behavior settings
CONFIG_ZMK_BEHAVIOR_LOCAL_ID_TYPE_CRC16=y
CONFIG_SETTINGS_NVS_SECTOR_COUNT=16

# USB CDC
CONFIG_USB_CDC_ACM_RINGBUF_SIZE=256
```
